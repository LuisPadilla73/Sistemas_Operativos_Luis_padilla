## debug/Kconfig/Kconfig.modules
```kconfig
menu "acpica (C:/Zephyr/zephyr/modules/lib/acpica)"
osource "$(ZEPHYR_ACPICA_KCONFIG)"
config ZEPHYR_ACPICA_MODULE
	bool
	default y
endmenu
menu "cmsis (C:/Zephyr/zephyr/modules/hal/cmsis)"
osource "$(ZEPHYR_CMSIS_KCONFIG)"
config ZEPHYR_CMSIS_MODULE
	bool
	default y
endmenu
menu "cmsis-dsp (C:/Zephyr/zephyr/modules/lib/cmsis-dsp)"
osource "$(ZEPHYR_CMSIS_DSP_KCONFIG)"
config ZEPHYR_CMSIS_DSP_MODULE
	bool
	default y
endmenu
menu "cmsis-nn (C:/Zephyr/zephyr/modules/lib/cmsis-nn)"
osource "$(ZEPHYR_CMSIS_NN_KCONFIG)"
config ZEPHYR_CMSIS_NN_MODULE
	bool
	default y
endmenu
menu "cmsis_6 (C:/Zephyr/zephyr/modules/hal/cmsis_6)"
osource "$(ZEPHYR_CMSIS_6_KCONFIG)"
config ZEPHYR_CMSIS_6_MODULE
	bool
	default y
endmenu
menu "fatfs (C:/Zephyr/zephyr/modules/fs/fatfs)"
osource "$(ZEPHYR_FATFS_KCONFIG)"
config ZEPHYR_FATFS_MODULE
	bool
	default y
endmenu
config ZEPHYR_ADI_MODULE
	bool
	default y
menu "hal_afbr (C:/Zephyr/zephyr/modules/hal/afbr)"
osource "$(ZEPHYR_HAL_AFBR_KCONFIG)"
config ZEPHYR_HAL_AFBR_MODULE
	bool
	default y

config ZEPHYR_HAL_AFBR_MODULE_BLOBS
	bool
endmenu
menu "hal_ambiq (C:/Zephyr/zephyr/modules/hal/ambiq)"
osource "$(ZEPHYR_HAL_AMBIQ_KCONFIG)"
config ZEPHYR_HAL_AMBIQ_MODULE
	bool
	default y
endmenu
config ZEPHYR_ATMEL_MODULE
	bool
	default y
menu "hal_bouffalolab (C:/Zephyr/zephyr/modules/hal/bouffalolab)"
osource "$(ZEPHYR_HAL_BOUFFALOLAB_KCONFIG)"
config ZEPHYR_HAL_BOUFFALOLAB_MODULE
	bool
	default y
endmenu
menu "hal_espressif (C:/Zephyr/zephyr/modules/hal/espressif)"
osource "C:/Zephyr/zephyr/modules/hal/espressif/zephyr/Kconfig"
config ZEPHYR_HAL_ESPRESSIF_MODULE
	bool
	default y

config ZEPHYR_HAL_ESPRESSIF_MODULE_BLOBS
	bool
endmenu
menu "hal_ethos_u (C:/Zephyr/zephyr/modules/hal/ethos_u)"
osource "$(ZEPHYR_HAL_ETHOS_U_KCONFIG)"
config ZEPHYR_HAL_ETHOS_U_MODULE
	bool
	default y
endmenu
menu "hal_gigadevice (C:/Zephyr/zephyr/modules/hal/gigadevice)"
osource "$(ZEPHYR_HAL_GIGADEVICE_KCONFIG)"
config ZEPHYR_HAL_GIGADEVICE_MODULE
	bool
	default y
endmenu
menu "hal_infineon (C:/Zephyr/zephyr/modules/hal/infineon)"
osource "$(ZEPHYR_HAL_INFINEON_KCONFIG)"
config ZEPHYR_HAL_INFINEON_MODULE
	bool
	default y

config ZEPHYR_HAL_INFINEON_MODULE_BLOBS
	bool
endmenu
menu "hal_intel (C:/Zephyr/zephyr/modules/hal/intel)"
osource "C:/Zephyr/zephyr/modules/hal/intel/zephyr/Kconfig"
config ZEPHYR_HAL_INTEL_MODULE
	bool
	default y
endmenu
config ZEPHYR_MICROCHIP_MODULE
	bool
	default y
menu "hal_nordic (C:/Zephyr/zephyr/modules/hal/nordic)"
osource "$(ZEPHYR_HAL_NORDIC_KCONFIG)"
config ZEPHYR_HAL_NORDIC_MODULE
	bool
	default y

config ZEPHYR_HAL_NORDIC_MODULE_BLOBS
	bool
endmenu
config ZEPHYR_NUVOTON_MODULE
	bool
	default y
menu "hal_nxp (C:/Zephyr/zephyr/modules/hal/nxp)"
osource "$(ZEPHYR_HAL_NXP_KCONFIG)"
config ZEPHYR_HAL_NXP_MODULE
	bool
	default y
	select TAINT_BLOBS

config ZEPHYR_HAL_NXP_MODULE_BLOBS
	bool
	default y
endmenu
config ZEPHYR_OPENISA_MODULE
	bool
	default y
config ZEPHYR_QUICKLOGIC_MODULE
	bool
	default y
config ZEPHYR_HAL_RENESAS_MODULE
	bool
	default y

config ZEPHYR_HAL_RENESAS_MODULE_BLOBS
	bool
menu "hal_rpi_pico (C:/Zephyr/zephyr/modules/hal/rpi_pico)"
osource "$(ZEPHYR_HAL_RPI_PICO_KCONFIG)"
config ZEPHYR_HAL_RPI_PICO_MODULE
	bool
	default y
endmenu
menu "hal_sifli (C:/Zephyr/zephyr/modules/hal/sifli)"
osource "$(ZEPHYR_HAL_SIFLI_KCONFIG)"
config ZEPHYR_HAL_SIFLI_MODULE
	bool
	default y
endmenu
menu "hal_silabs (C:/Zephyr/zephyr/modules/hal/silabs)"
osource "$(ZEPHYR_HAL_SILABS_KCONFIG)"
config ZEPHYR_HAL_SILABS_MODULE
	bool
	default y

config ZEPHYR_HAL_SILABS_MODULE_BLOBS
	bool
endmenu
menu "hal_st (C:/Zephyr/zephyr/modules/hal/st)"
osource "$(ZEPHYR_HAL_ST_KCONFIG)"
config ZEPHYR_HAL_ST_MODULE
	bool
	default y
endmenu
config ZEPHYR_HAL_STM32_MODULE
	bool
	default y

config ZEPHYR_HAL_STM32_MODULE_BLOBS
	bool
menu "hal_tdk (C:/Zephyr/zephyr/modules/hal/tdk)"
osource "$(ZEPHYR_HAL_TDK_KCONFIG)"
config ZEPHYR_HAL_TDK_MODULE
	bool
	default y
endmenu
menu "hal_telink (C:/Zephyr/zephyr/modules/hal/telink)"
osource "C:/Zephyr/zephyr/modules/hal/telink/Kconfig"
config ZEPHYR_HAL_TELINK_MODULE
	bool
	default y
endmenu
config ZEPHYR_TI_MODULE
	bool
	default y
menu "hal_wch (C:/Zephyr/zephyr/modules/hal/wch)"
osource "$(ZEPHYR_HAL_WCH_KCONFIG)"
config ZEPHYR_HAL_WCH_MODULE
	bool
	default y
endmenu
config ZEPHYR_HAL_WURTHELEKTRONIK_MODULE
	bool
	default y
config ZEPHYR_XTENSA_MODULE
	bool
	default y
menu "hostap (C:/Zephyr/zephyr/modules/lib/hostap)"
osource "$(ZEPHYR_HOSTAP_KCONFIG)"
config ZEPHYR_HOSTAP_MODULE
	bool
	default y
endmenu
menu "liblc3 (C:/Zephyr/zephyr/modules/lib/liblc3)"
osource "$(ZEPHYR_LIBLC3_KCONFIG)"
config ZEPHYR_LIBLC3_MODULE
	bool
	default y
endmenu
config ZEPHYR_LIBMCTP_MODULE
	bool
	default y
config ZEPHYR_LIBMETAL_MODULE
	bool
	default y
menu "libsbc (C:/Zephyr/zephyr/modules/lib/libsbc)"
osource "$(ZEPHYR_LIBSBC_KCONFIG)"
config ZEPHYR_LIBSBC_MODULE
	bool
	default y
endmenu
menu "littlefs (C:/Zephyr/zephyr/modules/fs/littlefs)"
osource "$(ZEPHYR_LITTLEFS_KCONFIG)"
config ZEPHYR_LITTLEFS_MODULE
	bool
	default y
endmenu
menu "lora-basics-modem (C:/Zephyr/zephyr/modules/lib/lora-basics-modem)"
osource "$(ZEPHYR_LORA_BASICS_MODEM_KCONFIG)"
config ZEPHYR_LORA_BASICS_MODEM_MODULE
	bool
	default y
endmenu
menu "loramac-node (C:/Zephyr/zephyr/modules/lib/loramac-node)"
osource "$(ZEPHYR_LORAMAC_NODE_KCONFIG)"
config ZEPHYR_LORAMAC_NODE_MODULE
	bool
	default y
endmenu
menu "lvgl (C:/Zephyr/zephyr/modules/lib/gui/lvgl)"
osource "C:/Zephyr/zephyr/modules/lib/gui/lvgl/zephyr/Kconfig"
config ZEPHYR_LVGL_MODULE
	bool
	default y
endmenu
menu "mbedtls (C:/Zephyr/zephyr/modules/crypto/mbedtls)"
osource "$(ZEPHYR_MBEDTLS_KCONFIG)"
config ZEPHYR_MBEDTLS_MODULE
	bool
	default y
endmenu
config ZEPHYR_MCUBOOT_MODULE
	bool
	default y
config ZEPHYR_MIPI_SYS_T_MODULE
	bool
	default y
menu "nanopb (C:/Zephyr/zephyr/modules/lib/nanopb)"
osource "$(ZEPHYR_NANOPB_KCONFIG)"
config ZEPHYR_NANOPB_MODULE
	bool
	default y
endmenu
menu "nrf_wifi (C:/Zephyr/zephyr/modules/lib/nrf_wifi)"
osource "$(ZEPHYR_NRF_WIFI_KCONFIG)"
config ZEPHYR_NRF_WIFI_MODULE
	bool
	default y

config ZEPHYR_NRF_WIFI_MODULE_BLOBS
	bool
endmenu
config ZEPHYR_OPEN_AMP_MODULE
	bool
	default y
menu "openthread (C:/Zephyr/zephyr/modules/lib/openthread)"
osource "$(ZEPHYR_OPENTHREAD_KCONFIG)"
config ZEPHYR_OPENTHREAD_MODULE
	bool
	default y
endmenu
menu "percepio (C:/Zephyr/zephyr/modules/debug/percepio)"
osource "C:/Zephyr/zephyr/modules/debug/percepio/zephyr/Kconfig"
config ZEPHYR_PERCEPIO_MODULE
	bool
	default y
endmenu
menu "picolibc (C:/Zephyr/zephyr/modules/lib/picolibc)"
osource "C:/Zephyr/zephyr/modules/lib/picolibc/zephyr/Kconfig"
config ZEPHYR_PICOLIBC_MODULE
	bool
	default y
endmenu
menu "segger (C:/Zephyr/zephyr/modules/debug/segger)"
osource "$(ZEPHYR_SEGGER_KCONFIG)"
config ZEPHYR_SEGGER_MODULE
	bool
	default y
endmenu
menu "trusted-firmware-a (C:/Zephyr/zephyr/modules/tee/tf-a/trusted-firmware-a)"
osource "$(ZEPHYR_TRUSTED_FIRMWARE_A_KCONFIG)"
config ZEPHYR_TRUSTED_FIRMWARE_A_MODULE
	bool
	default y
endmenu
menu "trusted-firmware-m (C:/Zephyr/zephyr/modules/tee/tf-m/trusted-firmware-m)"
osource "$(ZEPHYR_TRUSTED_FIRMWARE_M_KCONFIG)"
config ZEPHYR_TRUSTED_FIRMWARE_M_MODULE
	bool
	default y
endmenu
menu "uoscore-uedhoc (C:/Zephyr/zephyr/modules/lib/uoscore-uedhoc)"
osource "$(ZEPHYR_UOSCORE_UEDHOC_KCONFIG)"
config ZEPHYR_UOSCORE_UEDHOC_MODULE
	bool
	default y
endmenu
menu "zcbor (C:/Zephyr/zephyr/modules/lib/zcbor)"
osource "$(ZEPHYR_ZCBOR_KCONFIG)"
config ZEPHYR_ZCBOR_MODULE
	bool
	default y
endmenu
config ZEPHYR_NRF_HW_MODELS_MODULE
	bool
	default y
```

## debug/Kconfig/arch/Kconfig
```kconfig
# Load Zephyr Arch Kconfig descriptions.
osource "C:/Zephyr/zephyr/zephyr/arch/rx/Kconfig"
osource "C:/Zephyr/zephyr/zephyr/arch/x86/Kconfig"
osource "C:/Zephyr/zephyr/zephyr/arch/xtensa/Kconfig"
osource "C:/Zephyr/zephyr/zephyr/arch/sparc/Kconfig"
osource "C:/Zephyr/zephyr/zephyr/arch/riscv/Kconfig"
osource "C:/Zephyr/zephyr/zephyr/arch/posix/Kconfig"
osource "C:/Zephyr/zephyr/zephyr/arch/mips/Kconfig"
osource "C:/Zephyr/zephyr/zephyr/arch/arm64/Kconfig"
osource "C:/Zephyr/zephyr/zephyr/arch/arm/Kconfig"
osource "C:/Zephyr/zephyr/zephyr/arch/arc/Kconfig"
```

## debug/Kconfig/boards/Kconfig.defconfig
```kconfig
# Load Zephyr board defconfig descriptions.
osource "C:/Zephyr/zephyr/zephyr/boards/nxp/frdm_k64f/Kconfig.defconfig"
```

## debug/Kconfig/boards/Kconfig.frdm_k64f
```kconfig
# Load board Kconfig descriptions.
osource "C:/Zephyr/zephyr/zephyr/boards/nxp/frdm_k64f/Kconfig.frdm_k64f"
```

## debug/Kconfig/boards/Kconfig.sysbuild
```kconfig
# Load Sysbuild board Kconfig descriptions.
osource "C:/Zephyr/zephyr/zephyr/boards/nxp/frdm_k64f/Kconfig.sysbuild"
```

## debug/Kconfig/soc/Kconfig
```kconfig
# Load Zephyr SoC Kconfig descriptions.
osource "C:/Zephyr/zephyr/zephyr/soc/xlnx/zynqmp/Kconfig"
osource "C:/Zephyr/zephyr/zephyr/soc/xlnx/zynq7000/Kconfig"
osource "C:/Zephyr/zephyr/zephyr/soc/xlnx/versalnet/Kconfig"
osource "C:/Zephyr/zephyr/zephyr/soc/xlnx/versal2/Kconfig"
osource "C:/Zephyr/zephyr/zephyr/soc/xen/Kconfig"
osource "C:/Zephyr/zephyr/zephyr/soc/wch/ch32v/Kconfig"
osource "C:/Zephyr/zephyr/zephyr/soc/ti/simplelink/Kconfig"
osource "C:/Zephyr/zephyr/zephyr/soc/ti/mspm0/Kconfig"
osource "C:/Zephyr/zephyr/zephyr/soc/ti/lm3s6965/Kconfig"
osource "C:/Zephyr/zephyr/zephyr/soc/ti/k3/Kconfig"
osource "C:/Zephyr/zephyr/zephyr/soc/telink/tlsr/Kconfig"
osource "C:/Zephyr/zephyr/zephyr/soc/starfive/jh71xx/Kconfig"
osource "C:/Zephyr/zephyr/zephyr/soc/st/stm32/Kconfig"
osource "C:/Zephyr/zephyr/zephyr/soc/snps/qemu_arc/Kconfig"
osource "C:/Zephyr/zephyr/zephyr/soc/snps/nsim/arc_v/Kconfig"
osource "C:/Zephyr/zephyr/zephyr/soc/snps/nsim/arc_classic/Kconfig"
osource "C:/Zephyr/zephyr/zephyr/soc/snps/hsdk4xd/Kconfig"
osource "C:/Zephyr/zephyr/zephyr/soc/snps/hsdk/Kconfig"
osource "C:/Zephyr/zephyr/zephyr/soc/snps/emsk/Kconfig"
osource "C:/Zephyr/zephyr/zephyr/soc/snps/emsdp/Kconfig"
osource "C:/Zephyr/zephyr/zephyr/soc/snps/arc_iot/Kconfig"
osource "C:/Zephyr/zephyr/zephyr/soc/silabs/Kconfig"
osource "C:/Zephyr/zephyr/zephyr/soc/sifli/sf32/Kconfig"
osource "C:/Zephyr/zephyr/zephyr/soc/sifive/sifive_freedom/Kconfig"
osource "C:/Zephyr/zephyr/zephyr/soc/sensry/Kconfig"
osource "C:/Zephyr/zephyr/zephyr/soc/rockchip/Kconfig"
osource "C:/Zephyr/zephyr/zephyr/soc/renode/riscv_virtual/Kconfig"
osource "C:/Zephyr/zephyr/zephyr/soc/renode/cortex_r8_virtual/Kconfig"
osource "C:/Zephyr/zephyr/zephyr/soc/renesas/smartbond/Kconfig"
osource "C:/Zephyr/zephyr/zephyr/soc/renesas/rz/Kconfig"
osource "C:/Zephyr/zephyr/zephyr/soc/renesas/rx/Kconfig"
osource "C:/Zephyr/zephyr/zephyr/soc/renesas/rcar/Kconfig"
osource "C:/Zephyr/zephyr/zephyr/soc/renesas/ra/Kconfig"
osource "C:/Zephyr/zephyr/zephyr/soc/realtek/ec/Kconfig"
osource "C:/Zephyr/zephyr/zephyr/soc/raspberrypi/rpi_pico/Kconfig"
osource "C:/Zephyr/zephyr/zephyr/soc/quicklogic/eos_s3/Kconfig"
osource "C:/Zephyr/zephyr/zephyr/soc/qemu/virt_riscv/Kconfig"
osource "C:/Zephyr/zephyr/zephyr/soc/qemu/malta/Kconfig"
osource "C:/Zephyr/zephyr/zephyr/soc/openisa/rv32m1/Kconfig"
osource "C:/Zephyr/zephyr/zephyr/soc/openhwgroup/cva6/Kconfig"
osource "C:/Zephyr/zephyr/zephyr/soc/oct/osd32mp15x/Kconfig"
osource "C:/Zephyr/zephyr/zephyr/soc/nxp/s32/Kconfig"
osource "C:/Zephyr/zephyr/zephyr/soc/nxp/rw/Kconfig"
osource "C:/Zephyr/zephyr/zephyr/soc/nxp/mcx/Kconfig"
osource "C:/Zephyr/zephyr/zephyr/soc/nxp/lpc/Kconfig"
osource "C:/Zephyr/zephyr/zephyr/soc/nxp/layerscape/Kconfig"
osource "C:/Zephyr/zephyr/zephyr/soc/nxp/kinetis/Kconfig"
osource "C:/Zephyr/zephyr/zephyr/soc/nxp/imxrt/Kconfig"
osource "C:/Zephyr/zephyr/zephyr/soc/nxp/imx/Kconfig"
osource "C:/Zephyr/zephyr/zephyr/soc/nuvoton/numicro/Kconfig"
osource "C:/Zephyr/zephyr/zephyr/soc/nuvoton/numaker/Kconfig"
osource "C:/Zephyr/zephyr/zephyr/soc/nuvoton/npcx/Kconfig"
osource "C:/Zephyr/zephyr/zephyr/soc/nuvoton/npcm/Kconfig"
osource "C:/Zephyr/zephyr/zephyr/soc/nordic/Kconfig"
osource "C:/Zephyr/zephyr/zephyr/soc/neorv32/Kconfig"
osource "C:/Zephyr/zephyr/zephyr/soc/native/inf_clock/Kconfig"
osource "C:/Zephyr/zephyr/zephyr/soc/microchip/sam/Kconfig"
osource "C:/Zephyr/zephyr/zephyr/soc/microchip/sam/sama7/Kconfig"
osource "C:/Zephyr/zephyr/zephyr/soc/microchip/sam/sam_d5x_e5x/Kconfig"
osource "C:/Zephyr/zephyr/zephyr/soc/microchip/pic32c/pic32cz_ca/Kconfig"
osource "C:/Zephyr/zephyr/zephyr/soc/microchip/pic32c/pic32cx_sg/Kconfig"
osource "C:/Zephyr/zephyr/zephyr/soc/microchip/pic32c/pic32cm_jh/Kconfig"
osource "C:/Zephyr/zephyr/zephyr/soc/microchip/miv/Kconfig"
osource "C:/Zephyr/zephyr/zephyr/soc/microchip/mec/Kconfig"
osource "C:/Zephyr/zephyr/zephyr/soc/mediatek/mt8xxx/Kconfig"
osource "C:/Zephyr/zephyr/zephyr/soc/lowrisc/opentitan/Kconfig"
osource "C:/Zephyr/zephyr/zephyr/soc/litex/litex_vexriscv/Kconfig"
osource "C:/Zephyr/zephyr/zephyr/soc/ite/ec/Kconfig"
osource "C:/Zephyr/zephyr/zephyr/soc/intel/raptor_lake/Kconfig"
osource "C:/Zephyr/zephyr/zephyr/soc/intel/panther_lake/Kconfig"
osource "C:/Zephyr/zephyr/zephyr/soc/intel/lakemont/Kconfig"
osource "C:/Zephyr/zephyr/zephyr/soc/intel/intel_socfpga_std/Kconfig"
osource "C:/Zephyr/zephyr/zephyr/soc/intel/intel_socfpga/Kconfig"
osource "C:/Zephyr/zephyr/zephyr/soc/intel/intel_niosv/Kconfig"
osource "C:/Zephyr/zephyr/zephyr/soc/intel/intel_ish/Kconfig"
osource "C:/Zephyr/zephyr/zephyr/soc/intel/intel_adsp/Kconfig"
osource "C:/Zephyr/zephyr/zephyr/soc/intel/elkhart_lake/Kconfig"
osource "C:/Zephyr/zephyr/zephyr/soc/intel/atom/Kconfig"
osource "C:/Zephyr/zephyr/zephyr/soc/intel/apollo_lake/Kconfig"
osource "C:/Zephyr/zephyr/zephyr/soc/intel/alder_lake/Kconfig"
osource "C:/Zephyr/zephyr/zephyr/soc/infineon/edge/Kconfig"
osource "C:/Zephyr/zephyr/zephyr/soc/infineon/cat3/Kconfig"
osource "C:/Zephyr/zephyr/zephyr/soc/infineon/cat1c/Kconfig"
osource "C:/Zephyr/zephyr/zephyr/soc/infineon/cat1b/Kconfig"
osource "C:/Zephyr/zephyr/zephyr/soc/infineon/cat1a/Kconfig"
osource "C:/Zephyr/zephyr/zephyr/soc/gd/gd32/Kconfig"
osource "C:/Zephyr/zephyr/zephyr/soc/gaisler/leon3/Kconfig"
osource "C:/Zephyr/zephyr/zephyr/soc/gaisler/gr716a/Kconfig"
osource "C:/Zephyr/zephyr/zephyr/soc/espressif/Kconfig"
osource "C:/Zephyr/zephyr/zephyr/soc/ene/kb1200/Kconfig"
osource "C:/Zephyr/zephyr/zephyr/soc/ene/kb106x/Kconfig"
osource "C:/Zephyr/zephyr/zephyr/soc/egis/Kconfig"
osource "C:/Zephyr/zephyr/zephyr/soc/efinix/sapphire/Kconfig"
osource "C:/Zephyr/zephyr/zephyr/soc/cdns/xtensa_sample_controller/Kconfig"
osource "C:/Zephyr/zephyr/zephyr/soc/cdns/sample_controller32/Kconfig"
osource "C:/Zephyr/zephyr/zephyr/soc/cdns/dc233c/Kconfig"
osource "C:/Zephyr/zephyr/zephyr/soc/brcm/bcmvk/Kconfig"
osource "C:/Zephyr/zephyr/zephyr/soc/brcm/bcm2712/Kconfig"
osource "C:/Zephyr/zephyr/zephyr/soc/brcm/bcm2711/Kconfig"
osource "C:/Zephyr/zephyr/zephyr/soc/bflb/Kconfig"
osource "C:/Zephyr/zephyr/zephyr/soc/atmel/sam0/Kconfig"
osource "C:/Zephyr/zephyr/zephyr/soc/atmel/sam/Kconfig"
osource "C:/Zephyr/zephyr/zephyr/soc/aspeed/Kconfig"
osource "C:/Zephyr/zephyr/zephyr/soc/arm/Kconfig"
osource "C:/Zephyr/zephyr/zephyr/soc/arm/beetle/Kconfig"
osource "C:/Zephyr/zephyr/zephyr/soc/antmicro/myra/Kconfig"
osource "C:/Zephyr/zephyr/zephyr/soc/andestech/Kconfig"
osource "C:/Zephyr/zephyr/zephyr/soc/amd/acp_6_0/Kconfig"
osource "C:/Zephyr/zephyr/zephyr/soc/ambiq/Kconfig"
osource "C:/Zephyr/zephyr/zephyr/soc/aesc/Kconfig"
osource "C:/Zephyr/zephyr/zephyr/soc/adi/max32/Kconfig"
```
